/**
 * @file replay_fixture.h
 * @brief A logged flight for the replay tests, and how to run the flight step on it.
 *
 * @details
 * A fixture (flight_*.h, generated by make_fixtures.py) holds a TeleMega log's axial acceleration
 * and pressure, and the events the TeleMega logged. replayFlight() turns that into what this flight
 * computer's sensors would have read and runs it through flight_harness.h, one loop pass at a time:
 * - 5 s on the pad before the log starts, at rest and at the log's first pressure, so the pad
 *   altitude average and the baro filters fill as they do before a real launch;
 * - in the log, the specific force is the logged acceleration plus 1 g, and pressure is as logged,
 *   both interpolated linearly between log samples (the log is 100 Hz in boost and coast and
 *   sparser under parachute);
 * - after the log ends, 30 s at rest at the last logged pressure.
 * The loop period varies deterministically between 300 and 700 us, as in the neutrality test.
 * The accelerometer can be perturbed (scale, bias, noise) through SensorModel.
 */
#pragma once

#include <math.h>
#include <stddef.h>
#include <stdint.h>

#include <vector>

struct ReplayFixture
{
  const char *name;
  const int32_t *deltas;
  size_t count;
  // TeleMega flight-state changes, ms of log time
  int32_t liftoffMs;
  int32_t burnoutMs;
  int32_t apogeeMs;
  int32_t mainMs;
  int32_t landedMs;
  // baro apogee: highest 5-sample median of logged height before the drogue charge
  int32_t peakMs;
  int32_t peakHeightCm;
  // logged height first below the main deployment altitude after apogee, and ground contact
  int32_t belowMainMs;
  int32_t groundContactMs;
  int32_t padAltitudeCm;
};

#ifndef REPLAY_NO_HARNESS
#include "../flight_harness.h"

// The accelerometer apogee threshold V4.7.2 used (accelVel < -10), removed from the flight step
// for #14; the replay still reports when it would have held, for comparison.
constexpr auto REMOVED_ACCEL_APOGEE_VEL_MPS = -10;
constexpr float REPLAY_PAD_SECONDS = 5.0F;
constexpr float REPLAY_REST_SECONDS = 30.0F;

/** The fixture's samples, decoded. Times are seconds of log time (0 = TeleMega liftoff). */
struct ReplayLog
{
  std::vector<float> t;
  std::vector<float> accel; // logged acceleration, m/s^2 (axial specific force less 1 g)
  std::vector<float> pressure;

  explicit ReplayLog(const ReplayFixture &f)
  {
    int32_t t0 = 0, a0 = 0, p0 = 0;
    for (size_t i = 0; i < f.count; i++)
    {
      t0 += f.deltas[3 * i];
      a0 += f.deltas[3 * i + 1];
      p0 += f.deltas[3 * i + 2];
      t.push_back(t0 * 0.01F);
      accel.push_back(a0 * 0.01F);
      pressure.push_back((float)p0);
    }
  }

  /** What the sensors see at a log time. */
  Truth at(float time) const
  {
    Truth truth = {STANDARD_GRAVITY, pressure.front(), 0.0F, 0.0F, 0.0F};
    if (time <= t.front())
    {
      return truth;
    }
    if (time >= t.back())
    {
      truth.pressurePa = pressure.back();
      return truth;
    }
    size_t lo = 0, hi = t.size() - 1;
    while (hi - lo > 1)
    {
      const size_t mid = (lo + hi) / 2;
      (t[mid] <= time ? lo : hi) = mid;
    }
    const float w = (time - t[lo]) / (t[hi] - t[lo]);
    truth.specificForce = STANDARD_GRAVITY + accel[lo] + w * (accel[hi] - accel[lo]);
    truth.pressurePa = pressure[lo] + w * (pressure[hi] - pressure[lo]);
    return truth;
  }

  /** Log time from loop clock microseconds. */
  static float logTime(uint32_t micros) { return micros * 1e-6F - REPLAY_PAD_SECONDS; }
};

/** Event times from a replay, seconds of log time; NAN when the event did not happen. */
struct ReplayResult
{
  float liftoff = NAN;
  float burnout = NAN;
  float apogee = NAN;
  float apogeeFire = NAN;
  float mainDeploy = NAN;
  float touchdown = NAN;
  // apogee detection: when each detector (including the removed accelerometer one) first held
  // with the apogee gate open (burnout confirmed, false-liftoff check over), and which held on the
  // pass that set events.apogee
  float accelApogee = NAN;
  float baroApogee = NAN;
  float fusionApogee = NAN;
  bool apogeeByAccel = false;
  bool apogeeByBaro = false;
  bool apogeeByFusion = false;
  float accelVelAtPeak = NAN;  // accelVel at the baro apogee
  float fusionVelAtPeak = NAN;
  float baroVelAtPeak = NAN;
  float maxAccelVel = NAN;
  uint32_t passes = 0;
  uint32_t maxActions = 0;
};

inline void replaySettings()
{
  configureSensors();
  configurePyros('A', 'M', 'N', 'N');
  settings.fltProfile = 'S';
  // the TeleMega's own deployment settings on these flights (its .eeprom config): main at 425 m,
  // apogee charge 3 s after apogee
  settings.mainDeployAlt = 425;
  settings.apogeeDelay = 3000000UL;
}

/**
 * @brief Replay a logged flight through the flight step. The caller sets the globals to their
 * start-up values first, then the settings (replaySettings() or its own).
 */
inline ReplayResult replayFlight(const ReplayFixture &fixture, const SensorModel &model = SensorModel())
{
  const ReplayLog log(fixture);
  ReplayResult r;
  LoopState loopState;
  loopState.model = model;
  const uint32_t end = (uint32_t)((REPLAY_PAD_SECONDS + log.t.back() + REPLAY_REST_SECONDS) * 1e6F);
  const float peak = fixture.peakMs * 0.001F;
  uint32_t jitter = 1U;
  uint32_t now = 0;
  float liftoffClock = NAN;
  while (now < end)
  {
    jitter = jitter * 1103515245U + 12345U;
    now += 300 + (jitter >> 16) % 401;
    const float time = ReplayLog::logTime(now);
    const bool apogeeBefore = events.apogee;
    const FlightActions actions = runPass(loopState, now, log.at(time));
    r.passes++;
    if (actions.count > r.maxActions)
    {
      r.maxActions = actions.count;
    }
    if (isnan(liftoffClock) && (events.liftoff || events.touchdown || events.timeOut))
    {
      liftoffClock = ReplayLog::logTime(fltTime.liftoff);
      r.liftoff = liftoffClock;
    }
    if (isnan(liftoffClock))
    {
      continue;
    }
    // the apogee gate and the three detectors, as checkEvents() evaluates them
    const bool gate = events.boosterBurnout && !events.boosterBurnoutCheck && !events.falseLiftoffCheck;
    const bool accelDet = accelVel < REMOVED_ACCEL_APOGEE_VEL_MPS;
    const bool baroDet = baro.vel < BARO_APOGEE_VEL_MPS && accelVel < BARO_APOGEE_MACH_LOCK_MPS && (baro.alt + baro.baseAlt) < BARO_APOGEE_CEILING_M;
    const bool fusionDet = fusionVel < 0;
    if (gate && accelDet && isnan(r.accelApogee) && !events.apogeeFire)
    {
      r.accelApogee = time;
    }
    if (gate && baroDet && isnan(r.baroApogee) && !events.apogeeFire)
    {
      r.baroApogee = time;
    }
    if (gate && fusionDet && isnan(r.fusionApogee) && !events.apogeeFire)
    {
      r.fusionApogee = time;
    }
    if (!apogeeBefore && events.apogee)
    {
      r.apogeeByAccel = accelDet;
      r.apogeeByBaro = baroDet;
      r.apogeeByFusion = fusionDet;
    }
    if (isnan(r.accelVelAtPeak) && time >= peak)
    {
      r.accelVelAtPeak = accelVel;
      r.fusionVelAtPeak = fusionVel;
      r.baroVelAtPeak = baro.vel;
    }
    if (isnan(r.maxAccelVel) || accelVel > r.maxAccelVel)
    {
      r.maxAccelVel = accelVel;
    }
  }
  const auto at = [&](bool happened, unsigned long us) { return happened ? liftoffClock + us * 1e-6F : NAN; };
  r.burnout = at(events.boosterBurnout, fltTime.boosterBurnout);
  r.apogee = at(events.apogee, fltTime.apogee);
  r.apogeeFire = at(events.apogeeFire, fltTime.apogeeFire);
  r.mainDeploy = at(events.mainDeploy, fltTime.mainDeploy);
  r.touchdown = at(events.touchdown || events.timeOut, fltTime.touchdown);
  return r;
}
#endif
